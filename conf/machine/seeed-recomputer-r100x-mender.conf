## conf/machine/seeed-recomputer-r100x-mender.conf
```bitbake
#@TYPE: Machine
#@NAME: Seeed reComputer-R100x
#@SOC: broadcom bcm2711
#@DESCRIPTION: Machine configuration for seeed reComputer-R100x
#@MAINTAINER: ruiqian tang <ruiqian.tang@seeed.cc>

require conf/machine/raspberrypi4-64.conf

PREFERRED_VERSION_linux-raspberrypi ?= "6.1.%"

RPI_KERNEL_DEVICETREE_OVERLAYS:append = " overlays/reComputer-R100x.dtbo overlays/i2c0.dtbo \ 
overlays/i2c1.dtbo overlays/i2c3.dtbo overlays/i2c6.dtbo"
KERNEL_MODULE_AUTOLOAD:rpi += "i2c-dev"
ENABLE_I2C = "1"
ENABLE_UART = "1"

# mender conf
MENDER_ARTIFACT_NAME = "release-1"
INHERIT += "mender-full"
RPI_USE_U_BOOT = "1"
MENDER_BOOT_PART_SIZE_MB = "64"
IMAGE_INSTALL:append = " kernel-image kernel-devicetree"
IMAGE_FSTYPES:remove = " rpi-sdimg"
MENDER_FEATURES_ENABLE:append = " mender-uboot mender-image-sd"
MENDER_FEATURES_DISABLE:append = " mender-grub mender-image-uefi"
MENDER_STORAGE_TOTAL_SIZE_MB = "2048"
```

## conf/machine/seeed-recomputer-r100x.conf
```bitbake
#@TYPE: Machine
#@NAME: Seeed reComputer-R100x
#@SOC: broadcom bcm2711
#@DESCRIPTION: Machine configuration for seeed reComputer-R100x
#@MAINTAINER: ruiqian tang <ruiqian.tang@seeed.cc>

require conf/machine/raspberrypi4-64.conf

PREFERRED_VERSION_linux-raspberrypi ?= "6.1.%"

RPI_KERNEL_DEVICETREE_OVERLAYS:append = " overlays/reComputer-R100x.dtbo overlays/i2c0.dtbo \ 
overlays/i2c1.dtbo overlays/i2c3.dtbo overlays/i2c6.dtbo"
PACKAGECONFIG:append:pn-qtbase = " eglfs "
KERNEL_MODULE_AUTOLOAD:rpi += "i2c-dev"
ENABLE_I2C = "1"
ENABLE_UART = "1"
```

## conf/machine/seeed-recomputer-r110x.conf
```bitbake
#@TYPE: Machine
#@NAME: Seeed reComputer-R110x
#@SOC: broadcom bcm2711
#@DESCRIPTION: Machine configuration for seeed reComputer-R110x
#@MAINTAINER: ruiqian tang <ruiqian.tang@seeed.cc>

require conf/machine/raspberrypi4-64.conf

PREFERRED_VERSION_linux-raspberrypi ?= "6.1.%"

RPI_KERNEL_DEVICETREE_OVERLAYS:append = " overlays/reComputer-R110x.dtbo"
KERNEL_MODULE_AUTOLOAD:rpi += "i2c-dev"
ENABLE_I2C = "1"
ENABLE_UART = "1"
```

## conf/machine/seeed-recomputer-r2x-mender.conf
```bitbake
#@TYPE: Machine
#@NAME: Seeed reComputer-R2x
#@SOC: broadcom bcm2712
#@DESCRIPTION: Machine configuration for seeed reComputer-R2x with Mender support
#@MAINTAINER: ruiqian tang <ruiqian.tang@seeed.cc>

MACHINEOVERRIDES = "raspberrypi5:${MACHINE}"
require conf/machine/raspberrypi5.conf

PREFERRED_VERSION_linux-raspberrypi ?= "6.%"

# Device tree overlays from kernel source
RPI_KERNEL_DEVICETREE_OVERLAYS:append = " overlays/i2c0.dtbo overlays/i2c1.dtbo overlays/i2c3.dtbo overlays/i2c6.dtbo"

# Enable I2C and UART
KERNEL_MODULE_AUTOLOAD:rpi += "i2c-dev"
ENABLE_I2C = "1"
ENABLE_UART = "1"

# Essential packages for reComputer R2x
MACHINE_ESSENTIAL_EXTRA_RRECOMMENDS += "recomputer-r2x-detection seeed-linux-dtoverlays"

# Mender configuration
MENDER_ARTIFACT_NAME = "recomputer-r2x-release-1"
INHERIT += "mender-full"
RPI_USE_U_BOOT = "1"
MENDER_BOOT_PART_SIZE_MB = "100"
IMAGE_INSTALL:append = " kernel-image kernel-devicetree grub-editenv userlandtools"
IMAGE_FSTYPES:remove = " rpi-sdimg"
MENDER_FEATURES_ENABLE:append = " mender-uboot mender-image-sd"
MENDER_FEATURES_DISABLE:append = " mender-grub mender-image-uefi"
MENDER_STORAGE_TOTAL_SIZE_MB = "2048"

# Boot partition files configuration
# Copy device tree overlay to boot partition
IMAGE_BOOT_FILES:append = " reComputer-R2x.dtbo;overlays/reComputer-R2x.dtbo"

# Override userlandtools compatibility for this machine
COMPATIBLE_MACHINE:pn-userlandtools = "seeed-recomputer-r2x-mender"
```

## conf/machine/seeed-recomputer-r2x.conf
```bitbake
#@TYPE: Machine
#@NAME: Seeed reComputer-R2x
#@SOC: broadcom bcm2712
#@DESCRIPTION: Machine configuration for seeed reComputer-R2x
#@MAINTAINER: ruiqian tang <ruiqian.tang@seeed.cc>

MACHINEOVERRIDES = "raspberrypi5:${MACHINE}"
require conf/machine/raspberrypi5.conf

PREFERRED_VERSION_linux-raspberrypi ?= "6.%"

# Device tree overlays from kernel source
RPI_KERNEL_DEVICETREE_OVERLAYS:append = " overlays/i2c0.dtbo overlays/i2c1.dtbo overlays/i2c3.dtbo overlays/i2c6.dtbo"

# Enable I2C and UART
KERNEL_MODULE_AUTOLOAD:rpi += "i2c-dev"
ENABLE_I2C = "1"
ENABLE_UART = "1"

# Essential packages for reComputer R2x
MACHINE_ESSENTIAL_EXTRA_RRECOMMENDS += "recomputer-r2x-detection seeed-linux-dtoverlays"

# Boot partition files configuration
# Copy device tree overlay to boot partition
IMAGE_BOOT_FILES:append = " reComputer-R2x.dtbo;overlays/reComputer-R2x.dtbo"

# Override userlandtools compatibility for this machine
COMPATIBLE_MACHINE:pn-userlandtools = "seeed-recomputer-r2x"
```

## conf/machine/seeed-reterminal-DM-mender.conf
```bitbake
#@TYPE: Machine
#@NAME: Seeed reterminal plus
#@SOC: broadcom bcm2711
#@DESCRIPTION: Machine configuration for seeed reterminal DM
#@MAINTAINER: jian xiong <953308023@qq.com>

require conf/machine/raspberrypi4-64.conf

PREFERRED_VERSION_linux-raspberrypi ?= "6.1.%"

PACKAGECONFIG:append:pn-qtbase = " eglfs "
KERNEL_MODULE_AUTOLOAD:rpi += "i2c-dev"
ENABLE_I2C = "1"
ENABLE_UART = "1"

# mender conf
MENDER_ARTIFACT_NAME = "release-1"
INHERIT += "mender-full"
RPI_USE_U_BOOT = "1"
MENDER_BOOT_PART_SIZE_MB = "64"
IMAGE_INSTALL:append = " kernel-image kernel-devicetree"
IMAGE_FSTYPES:remove = " rpi-sdimg"
MENDER_FEATURES_ENABLE:append = " mender-uboot mender-image-sd"
MENDER_FEATURES_DISABLE:append = " mender-grub mender-image-uefi"
MENDER_STORAGE_TOTAL_SIZE_MB = "2048"
```

## conf/machine/seeed-reterminal-DM.conf
```bitbake
#@TYPE: Machine
#@NAME: Seeed reterminal plus
#@SOC: broadcom bcm2711
#@DESCRIPTION: Machine configuration for seeed reterminal DM
#@MAINTAINER: jian xiong <953308023@qq.com>

require conf/machine/raspberrypi4-64.conf

PREFERRED_VERSION_linux-raspberrypi ?= "6.1.%"

PACKAGECONFIG:append:pn-qtbase = " eglfs "
KERNEL_MODULE_AUTOLOAD:rpi += "i2c-dev"
ENABLE_I2C = "1"
ENABLE_UART = "1"
```

## conf/machine/seeed-reterminal-mender.conf
```bitbake
require conf/machine/raspberrypi4-64.conf

RPI_KERNEL_DEVICETREE_OVERLAYS:append = " overlays/reTerminal.dtbo overlays/i2c3.dtbo"
PACKAGECONFIG:append:pn-qtbase = " eglfs "
DISTRO_FEATURES:remove = " x11 wayland vulkan"
KERNEL_MODULE_AUTOLOAD:rpi += "i2c-dev"
ENABLE_I2C = "1"
ENABLE_UART = "1"

# mender conf
MENDER_ARTIFACT_NAME = "release-1"
INHERIT += "mender-full"
RPI_USE_U_BOOT = "1"
MENDER_BOOT_PART_SIZE_MB = "64"
IMAGE_INSTALL:append = " kernel-image kernel-devicetree"
IMAGE_FSTYPES:remove += " rpi-sdimg"
MENDER_FEATURES_ENABLE:append = " mender-uboot mender-image-sd"
MENDER_FEATURES_DISABLE:append = " mender-grub mender-image-uefi"
MENDER_STORAGE_TOTAL_SIZE_MB = "2048"
```

## conf/machine/seeed-reterminal-plus-mender.conf
```bitbake
#@TYPE: Machine
#@NAME: Seeed reterminal plus
#@SOC: broadcom bcm2711
#@DESCRIPTION: Machine configuration for seeed reterminal DM
#@MAINTAINER: jian xiong <953308023@qq.com>

require conf/machine/raspberrypi4-64.conf

PREFERRED_VERSION_linux-raspberrypi ?= "6.1.%"

RPI_KERNEL_DEVICETREE_OVERLAYS:append = " overlays/reTerminal-plus.dtbo overlays/i2c3.dtbo \ 
overlays/vc4-kms-v3d-pi4.dtbo"
PACKAGECONFIG:append:pn-qtbase = " eglfs "
KERNEL_MODULE_AUTOLOAD:rpi += "i2c-dev"
ENABLE_I2C = "1"
ENABLE_UART = "1"

# mender conf
MENDER_ARTIFACT_NAME = "release-1"
INHERIT += "mender-full"
RPI_USE_U_BOOT = "1"
MENDER_BOOT_PART_SIZE_MB = "64"
IMAGE_INSTALL:append = " kernel-image kernel-devicetree"
IMAGE_FSTYPES:remove = " rpi-sdimg"
MENDER_FEATURES_ENABLE:append = " mender-uboot mender-image-sd"
MENDER_FEATURES_DISABLE:append = " mender-grub mender-image-uefi"
MENDER_STORAGE_TOTAL_SIZE_MB = "2048"
```

## conf/machine/seeed-reterminal-plus.conf
```bitbake
#@TYPE: Machine
#@NAME: Seeed reterminal plus
#@SOC: broadcom bcm2711
#@DESCRIPTION: Machine configuration for seeed reterminal DM
#@MAINTAINER: jian xiong <953308023@qq.com>

require conf/machine/raspberrypi4-64.conf

PREFERRED_VERSION_linux-raspberrypi ?= "6.1.%"

RPI_KERNEL_DEVICETREE_OVERLAYS:append = " overlays/reTerminal-plus.dtbo overlays/i2c3.dtbo \ 
overlays/vc4-kms-v3d-pi4.dtbo"
PACKAGECONFIG:append:pn-qtbase = " eglfs "
KERNEL_MODULE_AUTOLOAD:rpi += "i2c-dev"
ENABLE_I2C = "1"
ENABLE_UART = "1"
```

## conf/machine/seeed-reterminal.conf
```bitbake
PREFERRED_VERSION_linux-raspberrypi ?= "6.1.%"

require conf/machine/raspberrypi4-64.conf

PACKAGECONFIG:append:pn-qtbase = " eglfs "
KERNEL_MODULE_AUTOLOAD:rpi += "i2c-dev"
ENABLE_I2C = "1"
ENABLE_UART = "1"

do_configure[network] = "1"
```
