## conf/machine/seeed-recomputer-r22.conf
```bitbake
#@TYPE: Machine
#@NAME: Seeed reComputer-R22
#@SOC: broadcom bcm2712
#@DESCRIPTION: Machine configuration for seeed reComputer-R22
#@MAINTAINER: ruiqian tang <ruiqian.tang@seeed.cc>

MACHINEOVERRIDES = "raspberrypi5:${MACHINE}"
require conf/machine/raspberrypi5.conf

PREFERRED_VERSION_linux-raspberrypi ?= "6.12%"

# Device tree overlays from kernel source
RPI_KERNEL_DEVICETREE_OVERLAYS:append = " overlays/i2c0.dtbo overlays/i2c1.dtbo overlays/i2c3.dtbo overlays/i2c6.dtbo"

# Enable I2C and UART
KERNEL_MODULE_AUTOLOAD:rpi += "i2c-dev"
ENABLE_UART = "1"

# Essential packages for reComputer R22
MACHINE_ESSENTIAL_EXTRA_RRECOMMENDS += "seeed-linux-dtoverlays"

# Boot partition files configuration
# Copy device tree overlay to boot partition
IMAGE_BOOT_FILES:append = " reComputer-R22.dtbo;overlays/reComputer-R22.dtbo "

# Override userlandtools compatibility for this machine
COMPATIBLE_MACHINE:pn-userlandtools = "seeed-recomputer-r22"
```
